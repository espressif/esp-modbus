## components/mb_console_helper/Kconfig.projbuild
```kconfig
menu "Modbus Console Helper"

    config MB_CONSOLE_HELPER_ENABLED
        bool "Enable console helper in examples"
        default y
        help
            Enable the helper component to track and send commands
            via the console (UART/USB).

    config MB_CONSOLE_CMD_AUTO_REGISTRATION
        bool "Enable Console command Modbus Auto-registration"
        default y
        help
            Enabling this allows for the autoregistration of the Modbus command.

endmenu
```

## examples/tcp/mb_tcp_slave/main/Kconfig.projbuild
```kconfig
menu "Modbus Example Configuration"

    config MB_SLAVE_ADDR
        int "Modbus slave address"
        range 1 247 if !FMB_TCP_UID_ENABLED
        range 0 247 if FMB_TCP_UID_ENABLED
        default 1
        help
            This is the Modbus slave address in the network.
            The address is used as an index to resolve slave ip address.

endmenu
```

## test/tcp/mb_tcp_slave/sdkconfig.defaults
```kconfig
#
# Modbus configuration
#
CONFIG_FMB_COMM_MODE_TCP_EN=y
CONFIG_FMB_TCP_PORT_DEFAULT=502
CONFIG_FMB_TCP_CONNECTION_TOUT_SEC=20
CONFIG_FMB_PORT_TASK_STACK_SIZE=4096
CONFIG_FMB_PORT_TASK_PRIO=10
CONFIG_FMB_COMM_MODE_RTU_EN=n
CONFIG_FMB_COMM_MODE_ASCII_EN=n
CONFIG_FMB_MASTER_TIMEOUT_MS_RESPOND=2000
CONFIG_FMB_MASTER_DELAY_MS_CONVERT=300
CONFIG_FMB_TIMER_USE_ISR_DISPATCH_METHOD=y
CONFIG_MB_MDNS_IP_RESOLVER=n
CONFIG_FMB_TCP_UID_ENABLED=n
CONFIG_MB_SLAVE_ADDR=1
CONFIG_EXAMPLE_CONNECT_IPV6=n
CONFIG_EXAMPLE_WIFI_SSID="${CI_WIFI_SSID}"
CONFIG_EXAMPLE_WIFI_PASSWORD="${CI_WIFI_PASSW}"

CONFIG_EXAMPLE_CONNECT_ETHERNET=n
CONFIG_EXAMPLE_CONNECT_WIFI=y
```

## test_apps/console_helper_test/sdkconfig.defaults
```kconfig
CONFIG_MB_CONSOLE_HELPER_ENABLED=y
CONFIG_MB_CONSOLE_CMD_AUTO_REGISTRATION=y
CONFIG_ESP_CONSOLE_UART_NUM=0
CONFIG_LOG_DEFAULT_LEVEL_INFO=y
```

## test_apps/cpp/modbus_serial_cpp_test/sdkconfig.defaults
```kconfig
# General options for test
CONFIG_HEAP_POISONING_COMPREHENSIVE=y
CONFIG_HEAP_TRACING_OFF=y
CONFIG_LOG_DEFAULT_LEVEL_DEBUG=n
CONFIG_LOG_MAXIMUM_LEVEL_DEBUG=y
```

## test_apps/unit_tests/mb_controller_mapping/main/Kconfig.projbuild
```kconfig
menu "Modbus Test Configuration"

    config MB_PORT_ADAPTER_EN
        bool "Enable Modbus port adapter to substitute hardware layer for test."
        default y
        help
                When option is enabled the port communication layer is substituted by 
                port adapter layer to allow testing of higher layers without access to physical layer.
    
    config MB_TEST_SLAVE_TASK_PRIO
        int "Modbus master test task priority"
        range 4 23
        default 4
        help
            Modbus master task priority for the test.

    config MB_TEST_MASTER_TASK_PRIO
        int "Modbus slave test task priority"
        range 4 23
        default 4
        help
            Modbus slave task priority for the test.

    config MB_TEST_COMM_CYCLE_COUNTER
        int "Modbus communication cycle counter for test"
        range 10 1000
        default 10
        help
            Modbus communication cycle counter for test.

    config MB_TEST_LEAK_WARN_LEVEL
        int "Modbus test leak warning level"
        range 4 256
        default 32
        help
            Modbus test leak warning level.

    config MB_TEST_LEAK_CRITICAL_LEVEL
        int "Modbus test leak critical level"
        range 4 1024
        default 64
        help
            Modbus test leak critical level.

endmenu
```

## test_apps/unit_tests/mb_ext_types/sdkconfig.defaults
```kconfig
# General options for test
CONFIG_FMB_EXT_TYPE_SUPPORT=y
CONFIG_LOG_DEFAULT_LEVEL_DEBUG=n
CONFIG_LOG_MAXIMUM_LEVEL_DEBUG=y
```

## test_apps/unit_tests/test_config_parser/sdkconfig.defaults
```kconfig
# General options for test
CONFIG_UNITY_ENABLE_FIXTURE=y
CONFIG_LOG_DEFAULT_LEVEL_DEBUG=n
CONFIG_LOG_MAXIMUM_LEVEL_DEBUG=y
```
